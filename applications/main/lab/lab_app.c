/**
 * @file lab_app.c
 * Flipper Lab: Chinese help pages for the built-in apps.
 *
 * Only draws text. OK on a detail page may queue the matching existing app
 * with the loader after this app exits; nothing here touches radio, IR, NFC,
 * RFID, iButton or GPIO hardware.
 */
#include <furi.h>
#include <gui/gui.h>
#include <gui/elements.h>
#include <input/input.h>
#include <loader/loader.h>

// Generated by scripts/generate_lab_font.py from lab_content.json
#include "lab_content.h"
#include "lab_font.h"

#define LAB_QUEUE_SIZE 8

typedef enum {
    LabScreenMenu,
    LabScreenDetail,
} LabScreen;

typedef struct {
    LabScreen screen;
    uint8_t topic;
    uint8_t page;
} LabState;

typedef struct {
    FuriMessageQueue* queue;
    FuriMutex* mutex; // guards state, written by the app thread, read by draw
    ViewPort* view_port;
    Gui* gui;
    LabState state;
} LabApp;

// Draws one line of at most max_w pixels. The generator already measured
// every string, so the cutting path only guards against a stale header.
static void lab_draw_text(Canvas* canvas, int32_t x, int32_t y, uint16_t max_w, const char* text) {
    if(canvas_string_width(canvas, text) <= max_w) {
        canvas_draw_str(canvas, x, y, text);
        return;
    }
    char buf[LAB_TEXT_MAX_BYTES + 1];
    size_t fit = 0;
    for(size_t end = 1; end <= LAB_TEXT_MAX_BYTES && text[end - 1]; end++) {
        buf[end - 1] = text[end - 1];
        if(((uint8_t)text[end] & 0xC0) == 0x80) continue; // inside a UTF-8 character
        buf[end] = '\0';
        if(canvas_string_width(canvas, buf) > max_w) break;
        fit = end;
    }
    buf[fit] = '\0';
    canvas_draw_str(canvas, x, y, buf);
}

static void
    lab_draw_chrome(Canvas* canvas, const char* title, const char* indicator, const char* footer) {
    uint16_t indicator_w = canvas_string_width(canvas, indicator);
    uint16_t title_w = LAB_INDICATOR_RIGHT - LAB_INDICATOR_GAP - LAB_TEXT_X;
    if(indicator_w < title_w) {
        canvas_draw_str(canvas, LAB_INDICATOR_RIGHT - indicator_w, LAB_TITLE_Y, indicator);
        title_w -= indicator_w;
    }
    lab_draw_text(canvas, LAB_TEXT_X, LAB_TITLE_Y, title_w, title);

    int32_t right = canvas_width(canvas) - 1;
    canvas_draw_line(canvas, 0, LAB_RULE_TOP, right, LAB_RULE_TOP);
    canvas_draw_line(canvas, 0, LAB_RULE_BOTTOM, right, LAB_RULE_BOTTOM);
    lab_draw_text(canvas, LAB_TEXT_X, LAB_FOOTER_Y, LAB_TEXT_MAX_W, footer);
}

// First visible menu row, keeping the selection in the middle when possible
static uint8_t lab_first_row(uint8_t topic) {
    if(LAB_TOPIC_COUNT <= LAB_ROWS || topic == 0) return 0;
    return MIN(topic - 1, LAB_TOPIC_COUNT - LAB_ROWS);
}

static void lab_draw_menu(Canvas* canvas, const LabState* state) {
    lab_draw_chrome(canvas, lab_menu_title, lab_topics[state->topic].indicator, lab_menu_footer);

    uint8_t first = lab_first_row(state->topic);
    for(uint8_t row = 0; row < LAB_ROWS && first + row < LAB_TOPIC_COUNT; row++) {
        uint8_t index = first + row;
        int32_t top = LAB_ROWS_TOP + row * LAB_ROW_H;
        if(index == state->topic) {
            canvas_draw_box(canvas, 0, top, LAB_LIST_W, LAB_ROW_H);
            canvas_set_color(canvas, ColorWhite);
        }
        lab_draw_text(
            canvas, LAB_TEXT_X, top + LAB_ROW_BASELINE, LAB_TEXT_MAX_W, lab_topics[index].label);
        canvas_set_color(canvas, ColorBlack);
    }
    elements_scrollbar_pos(
        canvas,
        canvas_width(canvas),
        LAB_ROWS_TOP,
        LAB_ROWS * LAB_ROW_H,
        state->topic,
        LAB_TOPIC_COUNT);
}

static void lab_draw_detail(Canvas* canvas, const LabState* state) {
    const LabTopic* topic = &lab_topics[state->topic];
    const LabPage* page = &topic->pages[state->page];
    lab_draw_chrome(canvas, topic->title, page->indicator, topic->footer);

    for(uint8_t row = 0; row < LAB_ROWS; row++) {
        if(!page->lines[row][0]) continue;
        int32_t y = LAB_ROWS_TOP + row * LAB_ROW_H + LAB_ROW_BASELINE;
        lab_draw_text(canvas, LAB_TEXT_X, y, LAB_TEXT_MAX_W, page->lines[row]);
    }
}

static void lab_draw_callback(Canvas* canvas, void* context) {
    LabApp* app = context;
    furi_check(furi_mutex_acquire(app->mutex, FuriWaitForever) == FuriStatusOk);
    LabState state = app->state;
    furi_check(furi_mutex_release(app->mutex) == FuriStatusOk);

    canvas_clear(canvas);
    canvas_set_color(canvas, ColorBlack);
    // Applies to this frame only: the GUI resets the canvas font before each redraw
    canvas_set_custom_u8g2_font(canvas, lab_font);
    if(state.screen == LabScreenMenu) {
        lab_draw_menu(canvas, &state);
    } else {
        lab_draw_detail(canvas, &state);
    }
}

static void lab_input_callback(InputEvent* event, void* context) {
    LabApp* app = context;
    // GUI thread: never wait here, drop the event if the queue is full
    furi_message_queue_put(app->queue, event, 0);
}

// Applies one key press. Returns false when the app should exit; *launch is
// set when OK on a detail page asked for an existing app.
static bool lab_process_key(LabState* state, InputKey key, const char** launch) {
    const LabTopic* topic = &lab_topics[state->topic];

    if(state->screen == LabScreenMenu) {
        switch(key) {
        case InputKeyUp:
            state->topic = (state->topic + LAB_TOPIC_COUNT - 1) % LAB_TOPIC_COUNT;
            break;
        case InputKeyDown:
            state->topic = (state->topic + 1) % LAB_TOPIC_COUNT;
            break;
        case InputKeyLeft: // one screen of topics up
            state->topic = state->topic >= LAB_ROWS ? state->topic - LAB_ROWS : 0;
            break;
        case InputKeyRight:
            state->topic = MIN(state->topic + LAB_ROWS, LAB_TOPIC_COUNT - 1);
            break;
        case InputKeyOk:
            state->screen = LabScreenDetail;
            state->page = 0;
            break;
        case InputKeyBack:
            return false;
        default:
            break;
        }
    } else {
        switch(key) {
        case InputKeyUp:
        case InputKeyLeft:
            if(state->page > 0) state->page--;
            break;
        case InputKeyDown:
        case InputKeyRight:
            if(state->page + 1 < topic->page_count) state->page++;
            break;
        case InputKeyOk:
            if(topic->launch) {
                *launch = topic->launch;
                return false;
            }
            break;
        case InputKeyBack:
            state->screen = LabScreenMenu;
            break;
        default:
            break;
        }
    }
    return true;
}

int32_t lab_app(void* p) {
    UNUSED(p);

    LabApp* app = malloc(sizeof(LabApp));
    app->state = (LabState){.screen = LabScreenMenu, .topic = 0, .page = 0};
    app->queue = furi_message_queue_alloc(LAB_QUEUE_SIZE, sizeof(InputEvent));
    app->mutex = furi_mutex_alloc(FuriMutexTypeNormal);
    app->view_port = view_port_alloc();
    view_port_draw_callback_set(app->view_port, lab_draw_callback, app);
    view_port_input_callback_set(app->view_port, lab_input_callback, app);
    app->gui = furi_record_open(RECORD_GUI);
    gui_add_view_port(app->gui, app->view_port, GuiLayerFullscreen);

    const char* launch = NULL;
    InputEvent event;
    bool running = true;
    while(running) {
        if(furi_message_queue_get(app->queue, &event, FuriWaitForever) != FuriStatusOk) continue;

        bool arrow = event.key == InputKeyUp || event.key == InputKeyDown ||
                     event.key == InputKeyLeft || event.key == InputKeyRight;
        if(event.type == InputTypeLong && event.key == InputKeyBack) {
            running = false;
        } else if(event.type == InputTypeShort || (event.type == InputTypeRepeat && arrow)) {
            furi_check(furi_mutex_acquire(app->mutex, FuriWaitForever) == FuriStatusOk);
            running = lab_process_key(&app->state, event.key, &launch);
            furi_check(furi_mutex_release(app->mutex) == FuriStatusOk);
            // Outside the state mutex: the draw callback takes it under the ViewPort lock
            view_port_update(app->view_port);
        }
    }

    // After removal no callback can run, so the queue and mutex can go
    view_port_enabled_set(app->view_port, false);
    gui_remove_view_port(app->gui, app->view_port);
    view_port_free(app->view_port);
    furi_record_close(RECORD_GUI);
    furi_message_queue_free(app->queue);
    furi_mutex_free(app->mutex);
    free(app);

    if(launch) {
        // Starts once this app has exited; the loader reports a missing app in a dialog
        Loader* loader = furi_record_open(RECORD_LOADER);
        loader_enqueue_launch(loader, launch, NULL, LoaderDeferredLaunchFlagGui);
        furi_record_close(RECORD_LOADER);
    }

    return 0;
}
